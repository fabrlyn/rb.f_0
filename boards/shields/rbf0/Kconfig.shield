## boards/shields/rbf0/Kconfig.shield
```kconfig
config SHIELD_RBF0_LEFT
    def_bool $(shields_list_contains,rbf0_left)

config SHIELD_RBF0_RIGHT
    def_bool $(shields_list_contains,rbf0_right)
```

## boards/shields/test-rb/Kconfig.defconfig
```kconfig
if SHIELD_RBF0_LEFT

config ZMK_KEYBOARD_NAME
    default "rbf0"

config ZMK_SPLIT_ROLE_CENTRAL
    default y

endif

if SHIELD_RBF0_LEFT || SHIELD_RBF0_RIGHT

config ZMK_SPLIT
    default y

endif
```

## boards/shields/test-rb/Kconfig.shield
```kconfig
config SHIELD_TEST_RB_LEFT
    def_bool $(shields_list_contains,test_rb_left)

config SHIELD_TEST_RB_RIGHT
    def_bool $(shields_list_contains,test_rb_right)
```
